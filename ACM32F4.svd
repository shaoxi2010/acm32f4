# ACM32F4 register map
Vendor: Aisinochip; Series: ACM32F4 Series; File version: 1.0
CPU: CM33 r2p1, little endian, MPU, FPU, 3 interrupt priority bits
Registers are 32-bit, read-write, reset 0x0 unless marked. A register's access mark holds for its fields unless they carry their own. Offsets are from the block's base; [hi:lo] are bit positions; lines under a group give offsets from that group; {n}, {i} and the like mark numbered series.

## SPI1 — SPI peripheral
Base 0x40020000
Same registers: SPI2 0x40020400, SPI4 0x40020C00
0x00 SPI_TX_DAT wo — SPI tx data
0x00 SPI_RX_DAT ro (alternate view of SPI_TX_DAT) — SPI rx data
0x04 SPI_BAUD — SPI baudrate
0x08 SPI_CTL — SPI control
0x0C SPI_TX_CTL — SPI tx control
0x10 SPI_RX_CTL — SPI rx control
0x14 SPI_IE — SPI interrupt enable
0x18 SPI_STATUS
0x1C SPI_TXDelay
0x20 SPI_BATCH — SPI batch number
0x24 SPI_CS wo
0x28 SPI_OUT_EN — SPI output auto enable

## SPI3 — SPI peripheral
Base 0x40020800
Registers as SPI1; these are added or differ:
0x00 SPI_TX_DAT — SPI tx data
0x00 SPI_RX_DAT (alternate view of SPI_TX_DAT) — SPI rx data
0x2C SPI_MEMO_ACC — SPI memery mode control
0x30 SPI_CMD — SPI memery CMD set
0x34 SPI_PARA — SPI memery parameter

## TIM1 — Advanced timer
Base 0x40012C00
Same registers: TIM3 0x40000400, TIM4 0x40000800
0x00 CR1 — control register 1
0x04 CR2 — control register 2
0x08 SMCR — slave mode control register
0x0C DIER — DMA/Interrupt enable register
0x10 SR — status register
0x14 EGR wo — event generation register
0x18 CCMR1_Output — capture/compare mode register (output mode)
0x18 CCMR1_Input (alternate view of CCMR1_Output) — capture/compare mode register 1 (input mode)
0x1C CCMR2_Output — capture/compare mode register (output mode)
0x1C CCMR2_Input (alternate view of CCMR2_Output) — capture/compare mode register 2 (input mode)
0x20 CCER — capture/compare enable register
0x24 CNT — counter
0x28 PSC — prescaler
0x2C ARR — auto-reload register
0x30 RCR — repetition counter register
{0x30+4i} CCR{i} (i=1..4) — capture/compare register {i}
0x44 BDTR — break and dead-time register
0x48 DCR — DMA control register
0x4C DMAR — DMA address for full transfer
0x60 AF1 — Multiplex function selection
0x68 TISEL — Input selection
0x6C DBER — DMA request type selection

## TIM2 — General-purpose timer
Base 0x40000000
Registers as TIM1, without RCR, BDTR.

## TIM14 — General-purpose timer
Base 0x40002000
Registers as TIM1, without CR2, SMCR, CCMR2_Output, CCMR2_Input, RCR, CCR{n} (n=1..4), BDTR, DCR, DMAR, AF1, TISEL, DBER.

## TIM15 — General-purpose timer
Base 0x40014000
Same registers: TIM16 0x40014400, TIM17 0x40014800
Registers as TIM1, without CCMR2_Output, CCMR2_Input, CCR3, CCR4.

## TIM6 — Basic timer
Base 0x40001000
Same registers: TIM7 0x40001400
0x00 CR1 — control register 1
0x08 SMCR — slave mode control register
0x0C DIER — DMA/Interrupt enable register
0x10 SR — status register
0x14 EGR wo — event generation register
0x24 CNT — counter
0x28 PSC — prescaler
0x2C ARR — auto-reload register

## ADC — Analog-to-digital converter
Base 0x40012400
0x00 SR ro — Status register
0x04 IE — ADC interrupt enable register
0x08 CR1 — ADC control register 1
0x0C CR2 — ADC control register 2
0x10 SMPR — ADC sampling time register
0x18 HTR — Analog watchdog higher threshold register
0x1C LTR — Analog watchdog lower threshold register
{0x1C+4i} SQR{i} (i=1..3) — Regular group sequence register {i}
0x2C JSQR — Injected sequence register
0x30 JDR ro — Injected channel data register
0x34 DR ro — Regular channel data register
0x38 DIFF — Differential/single-ended channel selection register
0x3C SIGN — Signed/unsigned data selection register
0x40 TSREF — Temperature and REF config register

## UART1
Base 0x40013800
Same registers: UART2 0x40004400, UART3 0x40004800, UART4 0x40004C00
0x00 DR ro
0x04 RSR ro
0x18 FR ro
0x20 ILPR
0x24 IBDR
0x28 FBDR
0x2C LCRH
0x30 CR
0x34 IFLS
0x38 IMSC
0x3C RIS ro
0x40 MIS ro — RIS
0x44 ICR wo
0x48 DMACR
0x54 CR2
0x58 BCNT

## I2S1
Base 0x40013000
0x00 DR
0x04 CR
0x08 PR
0x0C DIER
0x10 SR ro

## EFC
Base 0x00100000
0x00 CTRL
0x04 SEC wo
0x0C EFC_tERASE
0x10 EFC_tPROG
0x14 EFC_STATUS
0x18 EFC_INTSTATUS — INTSTATUS
0x1C EFC_INTEN

## OPAMP
Base 0x40010300
0x00 CSR1
0x04 CSR2
0x08 CSR3

## COMP
Base 0x40010200
0x00 CR1
0x04 CR2
0x08 SR ro
