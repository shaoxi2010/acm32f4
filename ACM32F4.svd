# ACM32F4 register map
Vendor: Aisinochip; Series: ACM32F4 Series; File version: 1.0
ARM 32-bit Cortex-M33 Microcontroller based device, CPU clock up to 180MHz, etc.
CPU: CM33 r2p1, little endian, MPU, FPU, 3 interrupt priority bits
Registers are 32-bit, read-write, reset 0x0 unless marked. A register's access mark holds for its fields unless they carry their own. Offsets are from the block's base; lines under a group give offsets from that group; [hi:lo] are bit positions; {n}, {i} and the like mark numbered series; 'fields as' and 'values as' point back to an identical list; <NAME> marks a mode.

## Memory map
0x00100000 EFC size 0x400
0x40000000 TIM2 size 0x400 — General-purpose timer
0x40000400 TIM3 size 0x400 — General-purpose timer
0x40000800 TIM4 size 0x400
0x40001000 TIM6 size 0x400 — Basic timer
0x40001400 TIM7 size 0x400
0x40002000 TIM14 size 0x400 — General-purpose timer
0x40002400 PMU size 0x400
0x40002800 RTC size 0x400
0x40002C00 WDT size 0x400
0x40003000 IWDT size 0x400
0x40004400 UART2 size 0x400
0x40004800 UART3 size 0x400
0x40004C00 UART4 size 0x400
0x40005400 I2C1 size 0x400
0x40005800 I2C2 size 0x400
0x40006400 CAN1 size 0x400
0x40006800 CAN2 size 0x400
0x40007400 DAC size 0x400
0x40008000 LPUART size 0x400
0x40010200 COMP size 0x400
0x40010300 OPAMP size 0x400
0x40010400 EXTI size 0x400
0x40010800 SCU size 0x400 — system register
0x40012400 ADC size 0x400 — Analog-to-digital converter
0x40012C00 TIM1 size 0x400 — Advanced timer
0x40013000 I2S1 size 0x400
0x40013800 UART1 size 0x400
0x40014000 TIM15 size 0x400 — General-purpose timer
0x40014400 TIM16 size 0x400
0x40014800 TIM17 size 0x400
0x4001F000 GPIO1 size 0x400
0x4001F400 GPIO2 size 0x400
0x4001F800 GPIO3 size 0x400
0x40020000 SPI1 size 0x400 — SPI peripheral
0x40020400 SPI2 size 0x400
0x40020800 SPI3 size 0x400 — SPI peripheral
0x40020C00 SPI4 size 0x400

## Interrupts
12 ADC_IRQn (ADC) — Adc interrupt
13 TIM1_BRK_UP_TRG_COM_IRQn (TIM1) — TIM1 break update trig com interrupt
14 TIM1_CC_IRQn (TIM1) — TIM1 Capture Compare interrupt
15 TIM2_IRQn (TIM2) — TIM2 interrupt
16 TIM3_IRQn (TIM3) — TIM3 interrupt
17 TIM6_IRQn (TIM6) — TIM6 interrupt
18 TIM7_IRQn (TIM7) — TIM7 interrupt
19 TIM14_IRQn (TIM14) — TIM14 interrupt
20 TIM15_IRQn (TIM15) — TIM15 interrupt
21 TIM16_IRQn (TIM16) — TIM16 interrupt
22 TIM17_IRQn (TIM17) — TIM17 interrupt
25 SPI1_IRQn (SPI1)
26 SPI2_IRQn (SPI2)
30 SPI3_IRQn (SPI3)
39 TIM4_IRQn (TIM4) — TIM4 interrupt
40 SPI4_IRQn (SPI4)

## DAC
Base 0x40007400
0x00 CR — DAC control register
0x04 SWTRGR wo — DAC software trigger register
0x08 DHR12R1 — DAC channel1 12-bit right-aligned data holding register
0x0C DHR12L1 — DAC channel1 12-bit left aligned data holding register
0x10 DHR8R1 — DAC channel1 8-bit right aligned data holding register
0x14 DHR12R2 — DAC channel2 12-bit right aligned data holding register
0x18 DHR12L2 — DAC channel2 12-bit left aligned data holding register
0x1C DHR8R2 — DAC channel2 8-bit right-aligned data holding register
0x20 DHR12RD — Dual DAC 12-bit right-aligned data holding register
0x24 DHR12LD — DUAL DAC 12-bit left aligned data holding register
0x28 DHR8RD — DUAL DAC 8-bit right aligned data holding register
0x2C DOR1 ro — DAC channel1 data output register
0x30 DOR2 ro — DAC channel2 data output register
0x34 SR — DAC status register
0x38 CCR — DAC calibration control register
0x3C MCR — DAC mode control register
0x40 SHSR1 — DAC Sample and Hold sample time register 1
0x44 SHSR2 — DAC Sample and Hold sample time register 2
0x48 SHHR reset 0x10001 — DAC Sample and Hold hold time register
0x4C SHRR reset 0x10001 — DAC Sample and Hold refresh time register

## Licence text in the file
ARM Limited (ARM) is supplying this software for use with Cortex-M processor based microcontroller, but can be equally used for other suitable processor architectures. This file can be freely distributed. Modifications to this file shall be clearly marked. . THIS SOFTWARE IS PROVIDED "AS IS". NO WARRANTIES, WHETHER EXPRESS, IMPLIED. OR STATUTORY, INCLUDING, BUT NOT LIMITED TO, IMPLIED WARRANTIES OF. MERCHANTABILITY AND FITNESS FOR A PARTICULAR PURPOSE APPLY TO THIS SOFTWARE. ARM SHALL NOT, IN ANY CIRCUMSTANCES, BE LIABLE FOR SPECIAL, INCIDENTAL, OR. CONSEQUENTIAL DAMAGES, FOR ANY REASON WHATSOEVER.

## Notices in the file
Copyright (C) 2012-2014 ARM Limited. All rights reserved.
Purpose: System Viewer Description (SVD) Example (Schema Version 1.1)
This is a description of a none-existent and incomplete device
for demonstration purposes only.
Redistribution and use in source and binary forms, with or without
modification, are permitted provided that the following conditions are met:
- Redistributions of source code must retain the above copyright
notice, this list of conditions and the following disclaimer.
- Redistributions in binary form must reproduce the above copyright
notice, this list of conditions and the following disclaimer in the
documentation and/or other materials provided with the distribution.
- Neither the name of ARM nor the names of its contributors may be used
to endorse or promote products derived from this software without
specific prior written permission.
THIS SOFTWARE IS PROVIDED BY THE COPYRIGHT HOLDERS AND CONTRIBUTORS "AS IS"
AND ANY EXPRESS OR IMPLIED WARRANTIES, INCLUDING, BUT NOT LIMITED TO, THE
ARE DISCLAIMED. IN NO EVENT SHALL COPYRIGHT HOLDERS AND CONTRIBUTORS BE
LIABLE FOR ANY DIRECT, INDIRECT, INCIDENTAL, SPECIAL, EXEMPLARY, OR
CONSEQUENTIAL DAMAGES (INCLUDING, BUT NOT LIMITED TO, PROCUREMENT OF
SUBSTITUTE GOODS OR SERVICES; LOSS OF USE, DATA, OR PROFITS; OR BUSINESS
INTERRUPTION) HOWEVER CAUSED AND ON ANY THEORY OF LIABILITY, WHETHER IN
CONTRACT, STRICT LIABILITY, OR TORT (INCLUDING NEGLIGENCE OR OTHERWISE)
ARISING IN ANY WAY OUT OF THE USE OF THIS SOFTWARE, EVEN IF ADVISED OF THE
POSSIBILITY OF SUCH DAMAGE.
