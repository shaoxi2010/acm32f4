# ACM32F4 register map
Vendor: Aisinochip; Series: ACM32F4 Series; File version: 1.0
CPU: CM33 r2p1, little endian, MPU, FPU, 3 interrupt priority bits
Registers are 32-bit, read-write, reset 0x0 unless marked. A register's access mark holds for its fields unless they carry their own. Offsets are from the block's base; [hi:lo] are bit positions; {n}, {i} and the like mark numbered series.

## CAN1
Base 0x40006400
Same registers: CAN2 0x40006800
0x00 CAN_MOD reset 0x3
0x04 CAN_CMR
0x08 CAN_SR ro reset 0x3C
0x0C CAN_IR ro
0x10 CAN_IER
0x18 CAN_BTR0
0x1C CAN_BTR1
0x20 CAN_OCR
0x2C CAN_ALC ro
0x30 CAN_ECC ro
0x34 CAN_EWLR
0x38 CAN_RXERR
0x3C CAN_TXERR
0x40 CAN_BUFF0
{0x40+4i} CAN_ACR{i} (alternate view of CAN_BUFF{i}) (i=0..3)
0x44 CAN_BUFF1
{0x40+4i} CAN_BUFF{i} reset 0x10001 (i=2..4)
{0x50+4i} CAN_AMR{i} (alternate view of CAN_BUFF{i+4}) (i=0..3)
{0x40+4i} CAN_BUFF{i} (i=5..12)
0x74 CAN_RMC ro
0x78 CAN_RBSA
0x7C CAN_CDR
0x80 CAN_RXFIFO
0x180 CAN_TXFIFO

## GPIO1
Base 0x4001F000
Same registers: GPIO2 0x4001F400, GPIO3 0x4001F800
0x00 GPIO_DIR reset 0x3
0x08 GPIO_SET wo reset 0x3C — GPIO_CLR
0x0C GPIO_CLR wo
0x10 GPIO_ODATA
0x14 GPIO_IDATA ro
0x18 GPIO_IEN
0x1C GPIO_IS
0x20 GPIO_IBE ro — CAN_ALC
0x24 GPIO_IEV ro
0x28 GPIO_IC wo
0x2C GPIO_RIS ro
0x30 GPIO_MIS ro

## EXTI
Base 0x40010400
0x00 IENR
0x04 EENR
0x08 RTENR
0x0C FTENR
0x10 SWIER
0x14 PDR
0x18 EXTICR1
0x1C EXTICR2 ro — CAN_ALC

## WDT
Base 0x40002C00
0x00 WDTLOAD reset 0xFFFFFFFF
0x04 WDTCOUNT reset 0xFFFFFFFF
0x08 WDTCTRL
0x0C WDTFEED wo
0x10 WDTINTCLRTIME reset 0x1000
0x14 WDTRIS ro

## IWDT
Base 0x40003000
0x00 IWDT_CMDR wo
0x04 IWDT_PR — WDTCOUNT
0x08 IWDT_RLR reset 0xFFF
0x0C IWDT_SR ro
0x10 IWDT_WINR reset 0xFFF
0x14 IWDT_WUTR reset 0xFFF

## LPUART
Base 0x40008000
0x00 LPUART_RXDR ro
0x04 LPUART_TXDR wo
0x08 LPUART_LCR — IWDT_RLR
0x0C LPUART_CR
0x10 LPUART_IBAUD
0x14 LPUART_FBAUD
0x18 LPUART_IE
0x1C LPUART_SR ro
0x20 LPUART_ADDR

## I2C1
Base 0x40005400
Same registers: I2C2 0x40005800
0x00 SLAVE_ADDR1 — I2C Device Address register1
0x04 CLK_DIV — I2C Clock Division register
0x08 CR — I2C Control register
0x0C SR reset 0x1 — I2C State register
0x10 DR — I2C Data register
0x14 SLAVE_ARR2_3 — I2C Device Address register2_3
0x1C FILTER
0x24 TIMEOUT — I2C Config Timeout register

## RTC
Base 0x40002800
0x00 WP
0x04 IE
0x08 SR
0x0C SEC
0x10 MIN
0x14 HOUR
0x18 DAY
0x1C WEEK
0x20 MONTH
0x24 YEAR
0x28 ALM
0x2C CR reset 0x400000
0x30 ADJUST
0x44 CLKSR1 ro
0x48 CALSR1 ro
0x4C CLKSF1 ro
0x50 CALPF1 ro
0x54 CLKSR2 ro
0x58 CALSR2 ro
0x5C CLKSF2 ro
0x60 CALPF2 ro
{0x70+4i} BAKUP{i} (i=0..4)

## PMU
Base 0x40002400
0x00 CR1
0x04 SR ro reset 0x10000
0x08 IOSEL
0x0C IOCR reset 0x700000
0x10 ANACR reset 0x20408338
0x14 CR2

## SCU — system register
Base 0x40010800
0x00 RCR — Reset control register
0x04 RSR — Reset source register
0x08 IPRSTR2 — Peripheral reset control register 2
0x0C IPRSTR1 — Peripheral reset control register 1
0x10 CCR1 — Clock control register 1
0x14 CCR2 — Clock control register 2
0x18 CIR — Clock interrupt register
0x1C IPCKENR1 — Peripheral enable control register 1
0x20 IPCKENR2 — Peripheral reset control register 2
0x24 RCHCR — RCH control register
0x28 XTHCR — XTH control register
0x2C PLLCR — PLL control register
0x30 LDOCR — LDO control register
0x38 WMR ro — Work mode register
0x3C CLKOCR — Clock output control register
0x40 VER ro — Version register
0x44 SYSCFG1 — System config register 1
0x48 LVDCFG — LVD config register
0x4C STOPCFG — STOP mode config register
0x54 PHYCFG — USBPHY control register
0x58 MEMCFG — Memory config register
0x5C DUMMY
0x60 PASEL1 — GPIOA function selection register 1
0x64 PASEL2 — GPIOA function selection register 2
0x68 PBSEL1 — GPIOB function selection register 1
0x6C PBSEL2 — GPIOB function selection register 2
0x70 PABPUR — GPIOA GPIOB pull up config register
0x74 PABPDR — GPIOA GPIOB pull down config register
0x78 PASTR — GPIOA output drive selection register
0x7C PBSTR — GPIOB output drive selection register
0x80 PABSMTR — GPIOA GPIOB SMT enable register
0x84 PABODR — GPIOA GPIOB open drain enable register
0x88 PABADS — GPIOA GPIOB digtal analog selection register
0x90 PCSEL1 — GPIOC function selection register 1
0x94 PCSEL2 — GPIOC function selection register 2
0x98 PDSEL1 — GPIOD function selection register 1
0x9C PDSEL2 — GPIOD function selection register 2
0xA0 PCDPUR — GPIOC GPIOD pull up config register
0xA4 PCDPDR — GPIOC GPIOD pull down config register
0xA8 PCSTR — GPIOC output drive selection register
0xAC PDSTR — GPIOD output drive selection register
0xB0 PCDSMTR — GPIOC GPIOD SMT enable register
0xB4 PCDODR — GPIOC GPIOD open drain enable register
0xB8 PCDADS — GPIOC GPIOD digtal analog selection register
0xC0 PESEL1 — GPIOE function selection register 1
0xC4 PESEL2 — GPIOE function selection register 2
0xC8 PFSEL1 — GPIOF function selection register 1
0xD0 PEFPUR — GPIOE GPIOF pull up config register
0xD4 PEFPDR — GPIOE GPIOE pull down config register
0xD8 PESTR — GPIOE output drive selection register
0xDC PFSTR — GPIOF output drive selection register
0xE0 PEFSMTR — GPIOE GPIOF SMT enable register
0xE4 PEFODR — GPIOE GPIOF open drain enable register
0xE8 PEFADS — GPIOE GPIOF digtal analog selection register
